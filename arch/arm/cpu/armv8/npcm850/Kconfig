## arch/arm/cpu/armv8/npcm850/Kconfig
```kconfig
config MAX_CPUS
	int "Maximum number of CPUs permitted for Arbel"
	default 4
	help
	  Set this number to the maximum number of possible CPUs in the SoC.
	  SoCs may have multiple clusters with each cluster may have multiple
	  ports. If some ports are reserved but higher ports are used for
	  cores, count the reserved ports. This will allocate enough memory
	  in spin table to properly handle all cores.
```

## arch/arm/dts/nuvoton-npcm750-linux-image.its
```
// SPDX-License-Identifier: GPL-2.0
/*
 * ITS file for the NPCM750 SoC
 *
 * Copyright (c) 2014-2018 Nuvoton Technology corporation.
 *
 */

/dts-v1/;

/ {

	description = "Nuvoton NPCM750 Simple image with single Linux kernel and ramdisk";
	#address-cells = <0x1>;

	images {
		kernel@1 {
			description = "Nuvoton NPCM750 Linux kernel";
			data = /incbin/("/home/ubuntu/shared/releases/poleg/programming_scripts/1.8.4/inputs/uImage");
			type = "kernel";
			arch = "arm";
			os = "linux";
			compression = "none";
            		load = <0x8000>;
            		entry = <0x8000>;
			hash@1 {
				algo = "sha256";
			};
			signature@1 {
				algo = "sha256,rsa2048";
				key-name-hint = "poleg";
				key-dir = "./build_output/tools/keys";
			};
		};
		ramdisk@1 {
			description = "Nuvoton NPCM750  Ramdisk Image";
			data = /incbin/("/home/ubuntu/shared/releases/poleg/programming_scripts/1.8.4/inputs/obmc-phosphor-image-evb-npcm750.cpio.lzma.u-boot");
			type = "ramdisk";
			arch = "arm";
			os = "linux";
			compression = "none";
			load = <0x01d00000>;
			entry = <0x01d00000>;
			hash@1 {
				algo = "sha256";
			};
			signature@1 {
				algo = "sha256,rsa2048";
				key-name-hint = "poleg";
				key-dir = "./build_output/tools/keys";
			};
		};
		fdt@1 {
			description = "Nuvoton NPCM750  dev tree";
			data = /incbin/("/home/ubuntu/shared/releases/poleg/programming_scripts/1.8.4/inputs/uImage-nuvoton-npcm750-evb.dtb");
			type = "flat_dt";
			arch = "arm";
			compression = "none";
			fdt-version = <1>;
			load = <0x1000000>;
			hash@1 {
				algo = "sha256";
			};
			signature@1 {
				algo = "sha256,rsa2048";
				key-name-hint = "poleg";
				key-dir = "./build_output/tools/keys";
			};
		};
	};

	configurations {
		default = "conf@1";
		conf@1 {
			description = "Nuvoton NPCM750 Boot Linux kernel, ramdisk and DT";
			kernel = "kernel@1";
			ramdisk = "ramdisk@1";
			dev_tree = "fdt@1";
		};
		hash@1 {
			algo = "sha256";
		};
		signature@1 {
			algo = "sha256,rsa2048";
			key-name-hint = "poleg";
			key-dir = "./build_output/tools/keys";
		};
	};
};
```

## arch/arm/mach-npcm/npcm8xx/Kconfig
```kconfig
if ARCH_NPCM8XX

config SYS_CPU
	default "armv8"

config SYS_SOC
	default "npcm8xx"

config TARGET_ARBEL_EVB
	bool "Arbel-EVB"

source "board/nuvoton/arbel/Kconfig"

endif
```

## arch/arm/mach-npcm850/Kconfig
```kconfig
if ARCH_NPCM850

choice
	prompt "NPCM board select"
	
config TARGET_ARBEL
	bool "Arbel board"
	
endchoice

config ARCH_NPCM
	bool "NUVOTON NPCMX Arch"

config TARGET_ARBEL_EVB
	bool "Arbel EVB board"

config TARGET_ARBEL_SVB
	bool "Arbel SVB board"
	
config TARGET_ARBEL_PALLADIUM
	bool "Arbel PALLADIUM board"
	
config SYS_SOC
	default "npcm850"

config SYS_MEM_TOP_HIDE
	hex "Reserved TOP memory"
	default 0x0 if NPCMX50_CORE0 || NPCMX50_CORE1 || NPCMX50_CORE2 || NPCMX50_CORE3
	default 0x7000000 if !NPCMX50_CORE0 && !NPCMX50_CORE1 && !NPCMX50_CORE2 && !NPCMX50_CORE3

source "board/nuvoton/arbel/Kconfig"

endif
```

## board/nuvoton/PolegSVB/Kconfig
```kconfig
if TARGET_NPCM750

config SYS_BOARD
	default "PolegSVB"

config SYS_VENDOR
	default "nuvoton"

config SYS_CPU
	default "armv7"

config SYS_SOC
	default "npcm750"

config SYS_CONFIG_NAME
	default "PolegSVB"

endif
```

## board/nuvoton/arbel/Kconfig
```kconfig
if TARGET_ARBEL_EVB

config SYS_BOARD
	default "arbel"

config SYS_VENDOR
	default "nuvoton"

config SYS_CONFIG_NAME
	default "arbel"

config SYS_MEM_TOP_HIDE
	hex "Reserved TOP memory"
	default 0x0
	help
	  Reserve memory for ECC/GFX/OPTEE/TIP/CP.

config EXT_TPM2_SPI
	bool "Support external TPM2 SPI device"
	default n

source "board/nuvoton/common/Kconfig"
endif
```

## cmd/nuvoton/Kconfig
```kconfig
config CMD_NUC_TST
	bool "mfgtest"
	default y
	help
	  Run MFG test.

config CMD_NUC_TST_HEADER_LOG
	bool "save mfgtest log in header"
	help
	  Save MFG test log in Header.

config CMD_GFX
	bool "gfx"
	help
	  gfx test commands.

config CMD_MCU
	bool "mcu"
	help
	  Nuvonton Runbmc MCU firmware update utility.

config CMD_FPU
	bool "fpu - floting Point SIMD+FPU test"
	select CC_OPTIMIZE_LIBS_FOR_SPEED
	help
	  builtin fpu test 
	  
config CMD_CACHE_PERF
	bool "Caches performence test"
	help
	  Nuvoton Caches performence test 

config CMD_CACHE_TEST
	bool "Caches test for ARMv8"
	depends on ARCH_NPCM850
	help
	  Nuvoton Cache test

config CMD_DDR_ECC
	bool "command for verifying DDR features"
	depends on ARCH_NPCM850
	help
	   Support for testing ddr on Nuvoton platforms. This command
	   supports memory verification, memory comapre and ecc
	   verification if supported.
	   
config CMD_NPCM_REGINFO
	bool "reginfo"
	depends on ARCH_NPCM850
	help
	  NPCM Register dump
	  
```

## configs/ArbelEVB_defconfig
```kconfig
CONFIG_ARM=y
CONFIG_ARCH_NPCM=y
CONFIG_ARCH_NPCM8XX=y
CONFIG_TARGET_ARBEL_EVB=y
CONFIG_SYS_TEXT_BASE=0x8000
CONFIG_DEFAULT_DEVICE_TREE="nuvoton-npcm850-evb"
CONFIG_ENV_IS_IN_SPI_FLASH=y
CONFIG_ENV_SIZE=0x10000
CONFIG_ENV_OFFSET=0x100000
CONFIG_ENV_SECT_SIZE=0x1000
CONFIG_SYS_MEMTEST_END=0x08000000
CONFIG_ENV_ADDR=0x90100000
CONFIG_SYS_MEMTEST_START=0
CONFIG_SF_DEFAULT_BUS=1
CONFIG_SF_DEFAULT_CS=0
CONFIG_NR_DRAM_BANKS=1

CONFIG_BOARD_EARLY_INIT_F=y

CONFIG_FIT=y
CONFIG_FIT_VERBOSE=y
CONFIG_HUSH_PARSER=y
CONFIG_MTD_DEVICE=y
CONFIG_MTD_PARTITIONS=y
CONFIG_OF_CONTROL=y

CONFIG_DM=y
CONFIG_DM_SERIAL=y
CONFIG_NPCMX50_SERIAL=y
CONFIG_TIMER=y
CONFIG_NPCMX50_TIMER=y
CONFIG_CLK=y
CONFIG_CMD_UUID=y
CONFIG_CMD_SAVEENV=y
# CONFIG_EFI is not set
# CONFIG_EFI_LOADER is not set
# CONFIG_ENV_IS_IN_FLASH is not set
# CONFIG_CMD_FLASH is not set
# CONFIG_MMC is not set
# CONFIG_NETDEVICES is not set
# CONFIG_PSCI_RESET is not set
```

## configs/ArbelSVB_defconfig
```kconfig
CONFIG_ARM=y
# CONFIG_POSITION_INDEPENDENT is not set
CONFIG_ARCH_NPCM=y
CONFIG_ARCH_NPCM850=y
CONFIG_TARGET_ARBEL=y
CONFIG_TARGET_ARBEL_SVB=y
# CONFIG_NPCMX50_CORE0 is not set
# CONFIG_NPCMX50_CORE1 is not set
# CONFIG_NPCMX50_CORE2 is not set
# CONFIG_NPCMX50_CORE3 is not set
CONFIG_SYS_TEXT_BASE=0x8000
CONFIG_NR_DRAM_BANKS=1
CONFIG_VERSION_VARIABLE=y
#CONFIG_CC_OPTIMIZE_LIBS_FOR_SPEED is not set
CONFIG_LAST_STAGE_INIT=y
CONFIG_FIT=y
CONFIG_FIT_VERBOSE=y
CONFIG_BOARD_EARLY_INIT_F=y
CONFIG_HUSH_PARSER=y
# CONFIG_CMD_XIMG is not set
# CONFIG_CMD_FLASH is not set
CONFIG_CMD_AES=y
CONFIG_NPCMX50_AES=y
CONFIG_CMD_FUSE=y
CONFIG_CMD_GPIO=y
CONFIG_CMD_HASH=y
CONFIG_CMD_I2C=y
CONFIG_CMD_MMC=y
CONFIG_MP=y
CONFIG_CMD_SF=y
CONFIG_CMD_SF_TEST=y
CONFIG_CMD_DHCP=y
CONFIG_CMD_MEMTEST=y
CONFIG_SYS_ALT_MEMTEST=y
CONFIG_BOOTP_PREFER_SERVERIP=y
CONFIG_CMD_PING=y
CONFIG_CMD_MII=y
CONFIG_CMD_CACHE=y
CONFIG_CMD_CACHE_PERF=y
CONFIG_CMD_RNG=y
CONFIG_CMD_UUID=y
CONFIG_CMD_FPU=y
CONFIG_CMD_DDR_ECC=y
CONFIG_CMD_TIME=y
CONFIG_CMD_CLK=y
# CONFIG_OF_SEPARATE is not set
CONFIG_OF_EMBED=y
CONFIG_DEFAULT_DEVICE_TREE="nuvoton-npcm850-svb"
CONFIG_ENV_IS_IN_SPI_FLASH=y
CONFIG_CLK=y
CONFIG_DM_GPIO=y
CONFIG_NPCMX50_GPIO=y
CONFIG_DM_I2C=y
CONFIG_NPCMX50_I2C=y
CONFIG_MISC=y
CONFIG_NPCMX50_OTP=y
CONFIG_NPCMX50_RNG=y
CONFIG_NPCMX50_SHA=y
CONFIG_SHA_HW_ACCEL=y
CONFIG_DM_MMC=y
CONFIG_MMC_SDHCI=y
CONFIG_MMC_SDHCI_SDMA=y
CONFIG_MMC_SDHCI_NPCMX50=y
CONFIG_MTD_DEVICE=y
CONFIG_DM_SPI_FLASH=y
CONFIG_SPI_FLASH=y
CONFIG_SPI_FLASH_BAR=y
CONFIG_SPI_FLASH_MACRONIX=y
CONFIG_SPI_FLASH_WINBOND=y
CONFIG_PHY_BROADCOM=y
CONFIG_DM_ETH=y
CONFIG_PHY_GIGE=y
CONFIG_ETH_DESIGNWARE=y
CONFIG_RGMII=y
CONFIG_MII=y
# CONFIG_ETH_NPCM750 is not set
CONFIG_DM_SERIAL=y
CONFIG_NPCMX50_SERIAL=y
CONFIG_SPI=y
CONFIG_DM_SPI=y
CONFIG_NPCMX50_FIU_SPI=y
CONFIG_NPCMX50_PSPI=y
CONFIG_CMD_SPI=y
# CONFIG_EFI_LOADER is not set
CONFIG_USB=y
CONFIG_USB_STORAGE=y
CONFIG_DM_USB=y
CONFIG_CMD_USB=y
CONFIG_USB_EHCI_HCD=y
CONFIG_USB_EHCI_NPCM8XX=y
CONFIG_USB_OHCI_HCD=y
CONFIG_USB_OHCI_GENERIC=y
CONFIG_USB_OHCI_NPCM8XX=y
CONFIG_CMD_FAT=y
CONFIG_FAT_WRITE=y
CONFIG_CI_UDC=y
CONFIG_USB_GADGET=y
CONFIG_USB_GADGET_DOWNLOAD=y
CONFIG_USB_GADGET_MASS_STORAGE=y
CONFIG_CMD_USB_MASS_STORAGE=y
CONFIG_USB_GADGET_MANUFACTURER="Nuvoton"
CONFIG_USB_GADGET_VENDOR_NUM=0x0416
CONFIG_USB_GADGET_PRODUCT_NUM=0xffff
CONFIG_PINCTRL_NPCM8XX=y
CONFIG_PINCTRL=y
CONFIG_PINCONF=y
CONFIG_CMD_NUC_TST=y
CONFIG_CMD_MCU=y
CONFIG_CMD_GFX=y
CONFIG_CMD_NPCM_REGINFO=y
```

## configs/PolegSVB_defconfig
```kconfig
CONFIG_ARM=y
CONFIG_ARCH_NPCM750=y
CONFIG_TARGET_POLEG=y
CONFIG_POLEG_SERIAL=y
CONFIG_DEFAULT_DEVICE_TREE="nuvoton-npcm750-evb"
CONFIG_SYS_TEXT_BASE=0x8200
CONFIG_NR_DRAM_BANKS=2
CONFIG_FIT=y
CONFIG_FIT_VERBOSE=y
CONFIG_MTD_DEVICE=y
CONFIG_MTD_PARTITIONS=y
# CONFIG_ENV_IS_IN_FLASH is not set
# CONFIG_CMD_FLASH is not set
CONFIG_CMD_SAVEENV=y
CONFIG_DM=y
CONFIG_DM_SERIAL=y
CONFIG_TIMER=y
CONFIG_NPCM750_TIMER=y
CONFIG_CLK=y
CONFIG_OF_CONTROL=y
CONFIG_OF_LIBFDT=y
CONFIG_LIB_RAND=y
# CONFIG_EFI is not set
# CONFIG_EFI_LOADER is not set
# CONFIG_CMD_IMLS is not set
# CONFIG_CMD_XIMG is not set
CONFIG_SYS_NO_FLASH=y
CONFIG_CMD_UUID=y
CONFIG_DM_SPI=y
CONFIG_DM_SPI_FLASH=y
CONFIG_SPI=y
CONFIG_SPI_FLASH=y
CONFIG_SPI_FLASH_MACRONIX=y
CONFIG_SPI_FLASH_WINBOND=y
CONFIG_NPCM750_FIU_SPI=y
CONFIG_CMD_SF=y
CONFIG_ENV_IS_IN_SPI_FLASH=y
CONFIG_SPI_FLASH_BAR=y
CONFIG_DM_MMC=y
CONFIG_DM_MMC_OPS=y
CONFIG_BLK=y
CONFIG_SDHCI=y
CONFIG_MMC=y
CONFIG_MMC_SDHCI=y
CONFIG_MMC_SDHCI_NPCMX50=y
CONFIG_CMD_MMC=y
CONFIG_CMD_GPIO=y
CONFIG_DM_GPIO=y
CONFIG_NPCM750_GPIO=y
CONFIG_DM_ETH=y
CONFIG_NETDEVICES=y
CONFIG_PHYLIB=y
CONFIG_ETH_DESIGNWARE=y
CONFIG_ETH_NPCM750=y
CONFIG_PHY_BROADCOM=y
CONFIG_RGMII=y
CONFIG_MII=y
CONFIG_PHY_GIGE=y
CONFIG_CMD_PING=y
CONFIG_MISC=y
CONFIG_NPCM750_OTP=y
CONFIG_CMD_FUSE=y
CONFIG_DM_I2C=y
CONFIG_NUVOTON_POLEG_I2C=y
CONFIG_CMD_I2C=y
CONFIG_CMD_CACHE=y
```

## drivers/crypto/Kconfig
```kconfig
menu "Hardware crypto devices"

source drivers/crypto/fsl/Kconfig

config NPCM750_AES
	bool "Support the NPCTM750 AES algorithm"
	select NPCM750_OTP
	help
	  This provides a means to encrypt and decrypt data using the NPCM750
	  AES (Advanced Encryption Standard). This algorithm uses a symetric
	  key and is widely used as a streaming cipher. This command only
	  supports AES256-CBC.

config NPCM750_SHA
	bool "Enable NPCM750 cryptographic HW SHA accelerator"
	help
	  This option enables support of NPCM750 cryptographic HW SHA accelerator.
	  It supports SHA1 and SHA256 hashing algorithms.

endmenu
```

## drivers/crypto/nuvoton/Kconfig
```kconfig
config NUVOTON_POLEG_SHA
	bool "Nuvoton BMC - Hardware crypto device drivers: SHA"
	help
	  Enables Nuvoton Cryptographic HW SHA accelerator.

config NUVOTON_POLEG_RNG
	bool "Nuvoton BMC - Hardware crypto device drivers: RNG"
	help
	  Enables Nuvoton Cryptographic HW RNG accelerator.
```
